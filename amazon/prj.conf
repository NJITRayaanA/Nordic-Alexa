## CMakeLists.txt
```
# SPDX-License-Identifier: Apache-2.0

cmake_minimum_required(VERSION 3.20.0)
find_package(Zephyr REQUIRED HINTS $ENV{ZEPHYR_BASE})
project(amazon)

target_sources(app PRIVATE src/main.c)
```

## sample.yaml
```
sample:
  name: Bluetooth Beacon
tests:
  sample.bluetooth.beacon:
    harness: bluetooth
    platform_allow:
      - qemu_cortex_m3
      - qemu_x86
      - nrf52dk_nrf52832
    tags: bluetooth
    integration_platforms:
      - qemu_cortex_m3

  sample.bluetooth.beacon-coex:
    extra_args: CONF_FILE="prj-coex.conf"
    harness: bluetooth
    platform_allow: nrf52840dk_nrf52840
    tags: bluetooth
```

## prj.conf
```kconfig
CONFIG_BT=y
CONFIG_LOG=y
CONFIG_BT_DEVICE_NAME="Dongle"
# Gadgets Profile
#CONFIG_BT_ALEXA_GADGETS_PROFILE=y
#CONFIG_BT_ALEXA_GADGETS_MODEL_NAME="Nordic Gadget"
#CONFIG_BT_ALEXA_GADGETS_DEVICE_DESCRIPTION="nRF5x DK"
#CONFIG_BT_ALEXA_GADGETS_AMAZON_ID="MY_DEVICE_ID"
#CONFIG_BT_ALEXA_GADGETS_DEVICE_SECRET="MY_DEVICE_SECRET"
#CONFIG_BT_ALEXA_GADGETS_CAPABILITY_ALERTS=y
#CONFIG_BT_ALEXA_GADGETS_CAPABILITY_NOTIFICATIONS=y
#CONFIG_BT_ALEXA_GADGETS_CAPABILITY_STATELISTENER=y
#CONFIG_BT_ALEXA_GADGETS_CAPABILITY_MUSICDATA=y
#CONFIG_BT_ALEXA_GADGETS_CAPABILITY_SPEECHDATA=y
#CONFIG_BT_ALEXA_GADGETS_CAPABILITY_CUSTOM=y
#CONFIG_BT_ALEXA_GADGETS_CAPABILITY_CUSTOM_NAMESPACE="Custom.ColorCyclerGadget"
```

## prj-coex.conf
```kconfig
CONFIG_BT=y
CONFIG_LOG=y
CONFIG_BT_DEVICE_NAME="Dongle"

CONFIG_BT_LL_SW_SPLIT=y
CONFIG_BT_CTLR_COEX_DRIVERS=y
CONFIG_BT_CTLR_COEX_TICKER=y
# Gadgets Profile
#CONFIG_BT_ALEXA_GADGETS_PROFILE=y
#CONFIG_BT_ALEXA_GADGETS_MODEL_NAME="Nordic Gadget"
#CONFIG_BT_ALEXA_GADGETS_DEVICE_DESCRIPTION="nRF5x DK"
#CONFIG_BT_ALEXA_GADGETS_AMAZON_ID="MY_DEVICE_ID"
#CONFIG_BT_ALEXA_GADGETS_DEVICE_SECRET="MY_DEVICE_SECRET"
#CONFIG_BT_ALEXA_GADGETS_CAPABILITY_ALERTS=y
#CONFIG_BT_ALEXA_GADGETS_CAPABILITY_NOTIFICATIONS=y
#CONFIG_BT_ALEXA_GADGETS_CAPABILITY_STATELISTENER=y
#CONFIG_BT_ALEXA_GADGETS_CAPABILITY_MUSICDATA=y
#CONFIG_BT_ALEXA_GADGETS_CAPABILITY_SPEECHDATA=y
#CONFIG_BT_ALEXA_GADGETS_CAPABILITY_CUSTOM=y
#CONFIG_BT_ALEXA_GADGETS_CAPABILITY_CUSTOM_NAMESPACE="Custom.ColorCyclerGadget"
```

## boards/nrf52840dk_nrf52840.overlay
```dts
/*
 * Copyright 2022 Dronetag
 *
 * SPDX-License-Identifier: Apache-2.0
 */
/{
    coex_gpio: coex {
        compatible = "gpio-radio-coex";
        grant-gpios = <&gpio1 0 (GPIO_PULL_DOWN | GPIO_ACTIVE_LOW)>;
        grant-delay-us = <150>;
    };
};

&radio {
    coex = <&coex_gpio>;
};
```

## src/main.c
```c
#include <zephyr/kernel.h>
#include <zephyr/drivers/sensor.h>
#include <zephyr/types.h>
#include <stddef.h>
#include <zephyr/sys/printk.h>
#include <zephyr/sys/util.h>
#include <zephyr/bluetooth/bluetooth.h>
#include <zephyr/bluetooth/conn.h>
#include <zephyr/bluetooth/hci.h>
#include <zephyr/bluetooth/gatt.h>
#include <zephyr/bluetooth/gatt.h>
//#include <zephyr/services/hids.h>
#include <zephyr/bluetooth/uuid.h>
#include <stdio.h>
#include <zephyr/logging/log.h>

#define DEVICE_NAME CONFIG_BT_DEVICE_NAME
#define DEVICE_NAME_LEN (sizeof(DEVICE_NAME) - 1)

/*#define BT_UUID_GATT_PRIMARY    BT_UUID_DECLARE_16(BT_UUID_GATT_PRIMARY_VAL)


static struct bt_uuid_128 vnd_uuid = BT_UUID_INIT_128(
	BT_UUID_128_ENCODE(0x0000FE03, 0x0000, 0x1000, 0x8000, 0x00805F9B34FB));

static struct bt_uuid_128 vnd_enc_uuid = BT_UUID_INIT_128(
	BT_UUID_128_ENCODE(0xF04EB177, 0x3005, 0x43A7, 0xAC61, 0xA390DDF83076));

static struct bt_uuid_128 vnd_auth_uuid = BT_UUID_INIT_128(
	BT_UUID_128_ENCODE(0x2BEEA05B, 0x1879, 0x4BB4, 0x8A2F, 0x72641F82420B));*/

static const struct bt_data ad[] = {
    BT_DATA_BYTES(BT_DATA_FLAGS,
            0x02,
            0x01,
            0x06,
            0x03,
            0x03),
    //BT_DATA_BYTES(BT_DATA_FLAGS, BT_LE_AD_NO_BREDR),
    BT_DATA_BYTES(BT_DATA_UUID16_ALL, 0xFE, 0x03),
    BT_DATA_BYTES(BT_DATA_SVC_DATA16,
            0x17,  // Length of the Service Data AD Type (23 bytes)
            0x16,  // Service Data AD Type identifier
            0xFE, 0x03,  // 16-bit UUID for Alexa
            0x01,0x71,
            0x00,  // Reserved for future use
            0xFF,  // Product category
            0x00,  // Reserved for future use
            0x01,  // Pairing or reconnection mode
    )
};


static const struct bt_data sd[] = {
    BT_DATA(BT_DATA_NAME_COMPLETE, DEVICE_NAME, DEVICE_NAME_LEN)
};

static void bt_ready(int err)
{
    char addr_s[BT_ADDR_LE_STR_LEN];
    bt_addr_le_t addr = {0};
    size_t count = 1;

    if (err) {
        printk("Bluetooth init failed (err %d)\n", err);
        return;
    }

    printk("Bluetooth initialized\n");


    err = bt_le_adv_start(BT_LE_ADV_NCONN_IDENTITY, ad, ARRAY_SIZE(ad),
                          sd, ARRAY_SIZE(sd));
    if (err) {
        printk("Advertising failed to start (err %d)\n", err);
        return;
    }

    bt_id_get(&addr, &count);
    bt_addr_le_to_str(&addr, addr_s, sizeof(addr_s));

    printk("Beacon started, advertising as %s\n", addr_s);
}

int main(void)
{
    int err;

    printk("Starting Amazon Beacon\n");

    err = bt_enable(bt_ready);
    if (err) {
        printk("Bluetooth init failed (err %d)\n", err);
    }
    return 0;
}


/*
#include <zephyr/types.h>
#include <stddef.h>
#include <zephyr/sys/printk.h>
#include <zephyr/sys/util.h>

#include <zephyr/bluetooth/bluetooth.h>
#include <zephyr/bluetooth/hci.h>

#define DEVICE_NAME CONFIG_BT_DEVICE_NAME
#define DEVICE_NAME_LEN (sizeof(DEVICE_NAME) - 1)


static const struct bt_data ad[] = {
	BT_DATA_BYTES(BT_DATA_FLAGS, BT_LE_AD_NO_BREDR),
	BT_DATA_BYTES(BT_DATA_UUID16_ALL, 0xaa, 0xfe),
	BT_DATA_BYTES(BT_DATA_SVC_DATA16,
		      0xaa, 0xfe,
		      0x10,
		      0x00,
		      0x00,
		      'z', 'e', 'p', 'h', 'y', 'r',
		      'p', 'r', 'o', 'j', 'e', 'c', 't',
		      0x08)
};


static const struct bt_data sd[] = {
	BT_DATA(BT_DATA_NAME_COMPLETE, DEVICE_NAME, DEVICE_NAME_LEN),
};

static void bt_ready(int err)
{
	char addr_s[BT_ADDR_LE_STR_LEN];
	bt_addr_le_t addr = {0};
	size_t count = 1;

	if (err) {
		printk("Bluetooth init failed (err %d)\n", err);
		return;
	}

	printk("Bluetooth initialized\n");


	err = bt_le_adv_start(BT_LE_ADV_NCONN_IDENTITY, ad, ARRAY_SIZE(ad),
			      sd, ARRAY_SIZE(sd));
	if (err) {
		printk("Advertising failed to start (err %d)\n", err);
		return;
	}



	bt_id_get(&addr, &count);
	bt_addr_le_to_str(&addr, addr_s, sizeof(addr_s));

	printk("Beacon started, advertising as %s\n", addr_s);
}

int main(void)
{
	int err;

	printk("Starting Beacon Demo\n");


	err = bt_enable(bt_ready);
	if (err) {
		printk("Bluetooth init failed (err %d)\n", err);
	}
	return 0;
}
*/
```
